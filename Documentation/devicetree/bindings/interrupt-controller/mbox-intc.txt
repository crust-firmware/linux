## Documentation/devicetree/bindings/interrupt-controller/mbox-intc.txt
```
Mailbox-backed Interrupt Controller
===================================

This binding represents an interrupt controller implemented in firmware,
that uses a mailbox channel to signal and acknowledge interrupts.

Device Node:
============

Required properties:
--------------------
- compatible:		Must be one of the following strings:
			- allwinner,sunxi-msgbox-intc
- interrupt-controller:	Signifies that this node is an interrupt controller.
- #interrupt-cells:	Must be 1.
- mboxes:		phandle for the mailbox controller and channel
			specifier. If the mailbox controller has unidirectional
			channels, two entries are required (see below).
- mbox-names:		Only required for unidirectional mailbox channels. In
			that case, it must contain the strings "tx" and "rx"
			(where "tx" and "rx" are from Linux's perspective, not
			the direction the interrupts are traveling).

Example:
--------

	msgbox_intc: interrupt-controller {
		compatible = "allwinner,sunxi-msgbox-intc";
		interrupt-controller;
		#interrupt-cells = <1>;
		mboxes = <&msgbox 6>, <&msgbox 7>;
		mbox-names = "tx", "rx";
	};
```

## Documentation/devicetree/bindings/mailbox/sunxi-msgbox.txt
```
Allwinner sunxi Message Box
===========================

The hardware message box on sunxi SoCs is a two-user mailbox controller
containing 8 unidirectional FIFOs bonded into 4 bidirectional mailbox channels.
An interrupt is raised for received messages, but software must poll to know
when a transmitted message has been acknowledged by the remote user.

Refer to ./mailbox.txt for generic information about mailbox device-tree
bindings.

Mailbox Device Node:
====================

Required properties:
--------------------
- compatible:		Must contain at least "allwinner,sun6i-a31-msgbox".
			Should also contain another SoC-specific string when
			used on other SoCs which are compatible, e.g.
			- allwinner,sun8i-h3-msgbox
			- allwinner,sun50i-a64-msgbox
- reg:			Contains the mailbox register address range (base
			address and length).
- clocks:		phandle for the clock controller and specifier.
- resets:		phandle for the reset controller and specifier.
- interrupts:		Contains interrupt information for the mailbox.
- #mbox-cells		Must be 2 - the indexes of the transmit and receive
			channels, respectively.

Example:
--------

	msgbox: mailbox@1c17000 {
		compatible = "allwinner,sun8i-h3-msgbox",
		             "allwinner,sun6i-a31-msgbox";
		reg = <0x01c17000 0x1000>;
		clocks = <&ccu CLK_BUS_MSGBOX>;
		resets = <&ccu RST_BUS_MSGBOX>;
		interrupts = <GIC_SPI 49 IRQ_TYPE_LEVEL_HIGH>;
		#mbox-cells = <2>;
	};
```
